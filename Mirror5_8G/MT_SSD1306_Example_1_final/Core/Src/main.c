/* USER CODE BEGIN Header */
/**
  ******************************************************************************
  * @file           : main.c
  * @brief          : Main program body
  ******************************************************************************
  * @attention
  *
  * <h2><center>&copy; Copyright (c) 2021 STMicroelectronics.
  * All rights reserved.</center></h2>
  *
  * This software component is licensed by ST under BSD 3-Clause license,
  * the "License"; You may not use this file except in compliance with the
  * License. You may obtain a copy of the License at:
  *                        opensource.org/licenses/BSD-3-Clause
  *
  ******************************************************************************
  */
/* USER CODE END Header */
/* Includes ------------------------------------------------------------------*/
#include "main.h"
#include "adc.h"
#include "dma.h"
#include "i2c.h"
#include "tim.h"
#include "usart.h"
#include "gpio.h"

/* Private includes ----------------------------------------------------------*/
/* USER CODE BEGIN Includes */
#include "ssd1306.h"
#include "math.h"

/* USER CODE END Includes */

/* Private typedef -----------------------------------------------------------*/
/* USER CODE BEGIN PTD */

/* USER CODE END PTD */

/* Private define ------------------------------------------------------------*/
/* USER CODE BEGIN PD */
#define Command_lengh	8
#define laser_lengh	9
#define dist_buffer_size   100
#define BUFFER_SIZE   1024
#define ADC_REFERENCE_VOLTAGE                                           1.2
#define ADC_MAX                                                         0xFFF
/* USER CODE END PD */

/* Private macro -------------------------------------------------------------*/
/* USER CODE BEGIN PM */

/* USER CODE END PM */

/* Private variables ---------------------------------------------------------*/

/* USER CODE BEGIN PV */
//typedef struct{
//uint64_t	time_usec;
//uint8_t	fix_type;
//int32_t	lat;
//int32_t	lon;
//int32_t	alt;
//uint16_t	eph;
//uint16_t	epv;
//uint16_t	vel;
//uint16_t	cog;
//uint8_t	satellites_visible;
//int32_t	alt_ellipsoid; 
//uint32_t	h_acc; 
//uint32_t	v_acc; 
//uint32_t	vel_acc;
//uint32_t	hdg_acc;
//uint16_t	yaw;
//}	 GPS_RAW; 

//GPS_RAW *pointer;
//GPS_RAW GPS_temp;

uint8_t command_word1[Command_lengh]={0xAE,0xA7,0x04,0x00,0x05,0x09,0xBC,0xBE};
uint8_t Laser_on[laser_lengh]=					{0xAE,0xA7,0x05,0x00,0x40,0x01,0x46,0xBC,0xBE};
uint8_t Laser_off[laser_lengh]=					{0xAE,0xA7,0x05,0x00,0x40,0x00,0x45,0xBC,0xBE};
uint8_t Laser_Calibration[Command_lengh]=	{0xAE,0xA7,0x04,0x00,0x0D,0x11,0xBC,0xBE};
uint8_t transmitBuffer[BUFFER_SIZE];
uint8_t receiveBuffer[BUFFER_SIZE];
uint8_t dist_buffer[dist_buffer_size];
volatile uint32_t messages[256];
volatile uint32_t messages_len[256];

 float mcuVoltage = 0;
 float batteryVoltage = 0;
 uint16_t adcData[2];
 uint64_t time;
 volatile uint32_t temp_dist,temp_data,roll_temp,pitch_temp,yaw_temp,lat,lon,alt,hdg,Laser_state,dist,count,Go_laser,cog,temp_data1,temp_data2;
 volatile int32_t lon_dist,lat_dist,batt_count;
 volatile int32_t roll_g,pitch_g,yaw_g,temp_state,Receive_on;
 volatile float roll,pitch,yaw,*point,temp_f[3],hdg_r,gor_dist,lon_r,lat_r,lon_m_g,batt_V,batt_PC;
 volatile uint8_t temp,gps_status,gps_count,timer_end,second_end,timer_step,timer_count,work_state,debug,new_meas;
 volatile const float Pi=3.1415926535;
 volatile const float lat_m_g=111318.845021;
 volatile const float lon_ekv=111317.0996921983;
 
 volatile const uint8_t ssd1306xled_font8x16[] = {
     0x00, // 0x00 means fixed font type - the only supported by the library
     0x08, // 0x08 = 8 - font width in pixels
     0x10, // 0x10 = 16 - font height in pixels
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     0x00, 0x06, 0x01, 0x01, 0x02, 0x02, 0x04, 0x04, 0x00, 0x00, 0x00, 0x00, 0x00, 0x00, 0x00, 0x00, // ~ 94
 };
 volatile const uint8_t ssd1306xled_font6x8 []=
 {
   0x00, 0x06, 0x08, 0x20,
   0x00, 0x00, 0x00, 0x00, 0x00, 0x00, //0 sp
   0x00, 0x00, 0x00, 0x2f, 0x00, 0x00, //1 !
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   0x14, 0x14, 0x14, 0x14, 0x14, 0x14, //6 horiz lines // DEL
   0x00 /* This byte is required for italic type of font */
 };
/* USER CODE END PV */

/* Private function prototypes -----------------------------------------------*/
void SystemClock_Config(void);
/* USER CODE BEGIN PFP */

/* USER CODE END PFP */

/* Private user code ---------------------------------------------------------*/
/* USER CODE BEGIN 0 */
 void HAL_GPIO_EXTI_Callback(uint16_t GPIO_Pin)
{
  /* Prevent unused argument(s) compilation warning */
  UNUSED(GPIO_Pin);
	//HAL_Delay(10);
	Go_laser=1;
  /* NOTE: This function Should not be modified, when the callback is needed,
           the HAL_GPIO_EXTI_Callback could be implemented in the user file
   */
}
 void Symvol_write_Led(uint8_t x, uint8_t y,uint8_t Data)
 {
		uint8_t k=0;
		uint8_t j = y;
		for (uint8_t ii = x; ii < x+8; ii++)
		{
//			SSD1306_DrawFilledRect_2(i,j,ssd1306xled_font6x8[Data*6+4+k++]);
				SSD1306_DrawFilledRect_2(ii,j,ssd1306xled_font8x16[ Data*16+4+k]);
				SSD1306_DrawFilledRect_2(ii,j+1,ssd1306xled_font8x16[ Data*16+12+k++]);
		}
 }
 
  void Symvol_write_debug(uint8_t x, uint8_t y,uint8_t Data)
 {
		uint8_t k=0;
		uint8_t j = y;
		for (uint8_t i = x; i < x+6; i++)
		{
			SSD1306_DrawFilledRect_2(i,j,ssd1306xled_font6x8[Data*6+4+k++]);
		}
 }
 
void write_Led()	
{
			uint32_t i,temp_pow;

			
	
			if(debug==1)
			{
			Symvol_write_debug(0,0,36);	// D
			Symvol_write_debug(6,0,41);	// I
			Symvol_write_debug(12,0,51);	// S
			Symvol_write_debug(18,0,52);	// T
			
			if(((uint32_t) dist)<20000)
			{			
				temp_data=(uint32_t) dist;	
				for(i=0,temp_pow=1;temp_pow<=(uint32_t) dist;i++)
				{
						temp=temp_data%10;
						Symvol_write_debug(52-i*6,0,16+temp);		// 
						if(temp_pow==1)
						{
							i++;
							Symvol_write_debug(52-i*6,0,14);		// . 
						}
						temp_data=temp_data/10;
						temp_pow=temp_pow*10;

				}
			}
			
			SSD1306_DrawFilledRect_2(99,0,0xff);
			for(i=0;i<20;i++)
			{
				if((batt_V/1000-7.4)>=i*0.05)
				{
					SSD1306_DrawFilledRect_2(100+i,0,0xff);
				}
				else
				{
					SSD1306_DrawFilledRect_2(100+i,0,0x81);
				}
			}
			SSD1306_DrawFilledRect_2(120,0,0x3c);
			SSD1306_DrawFilledRect_2(121,0,0x3c);
			

			Symvol_write_debug(0,1,39);		// G
			Symvol_write_debug(6,1,48);		// P
			Symvol_write_debug(12,1,51);		// S
			Symvol_write_debug(24,1,44);		// L
			Symvol_write_debug(30,1,33);		// A
			Symvol_write_debug(36,1,52);	// T
			if(((uint32_t) lat)<900000000)
			{		
				temp_data=(uint32_t) lat;	
				for(i=0,temp_pow=1;temp_pow<=lat;i++)
				{
						temp=temp_data%10;
						Symvol_write_debug(112-i*6,1,16+temp);		// 
						if(temp_pow==1000000)
						{
							i++;
							Symvol_write_debug(112-i*6,1,14);		// . 
						}
						temp_data=temp_data/10;
						temp_pow=temp_pow*10;
				}		
			}
			//			}
			Symvol_write_debug(0,2,39);		// G
			Symvol_write_debug(6,2,48);		// P
			Symvol_write_debug(12,2,51);		// S
			Symvol_write_debug(24,2,44);		// L
			Symvol_write_debug(30,2,47);		// O
			Symvol_write_debug(36,2,46);	// N
			if(((uint32_t)lon)<900000000)
			{			
				temp_data=(uint32_t) lon;	
				for(i=0,temp_pow=1;temp_pow<=lon;i++)
				{
						temp=temp_data%10;
						Symvol_write_debug(112-i*6,2,16+temp);		// 
						if(temp_pow==1000000)
						{
							i++;
							Symvol_write_debug(112-i*6,2,14);		// . 
						}
						temp_data=temp_data/10;
						temp_pow=temp_pow*10;
				}	
			}

			Symvol_write_debug(0,3,39);		// G
			Symvol_write_debug(6,3,48);		// P
			Symvol_write_debug(12,3,51);		// S
			Symvol_write_debug(24,3,33);		// A
			Symvol_write_debug(30,3,44);		// L
			Symvol_write_debug(36,3,52);	// T
			if(((uint32_t)alt)<900000000)
			{	
				temp_data=(uint32_t) alt;	
				for(i=0,temp_pow=1;temp_pow<=alt;i++)
				{
						temp=temp_data%10;
						Symvol_write_debug(112-i*6,3,16+temp);		// 
						if(temp_pow==1000)
						{
							i++;
							Symvol_write_debug(112-i*6,3,14);		// . 
						}
						temp_data=temp_data/10;
						temp_pow=temp_pow*10;
				}			
			}

			Symvol_write_debug(70,7,40);	// H
			Symvol_write_debug(76,7,36);	// D
			Symvol_write_debug(82,7,39);	// G
			
			if(((uint32_t)hdg)<36000)
			{			
				temp_data=(uint32_t) hdg;	
				for(i=0,temp_pow=1;temp_pow<=hdg;i++)
				{
					temp=temp_data%10;
					Symvol_write_debug(122-i*6,7,16+temp);		// 
					if(temp_pow==10)
					{
						i++;
						Symvol_write_debug(122-i*6,7,14);		// . 
					}
					temp_data=temp_data/10;
					temp_pow=temp_pow*10;
				}					
			}
			
			Symvol_write_debug(0,4,39);	// G
			Symvol_write_debug(6,4,48);	// P
			Symvol_write_debug(12,4,51);	// S
			

			temp_data= gps_count;	
			for(i=0,temp_pow=1;temp_pow<=gps_count;i++)
			{
				temp=temp_data%10;
				Symvol_write_debug(30-i*6,4,16+temp);		// 
				temp_data=temp_data/10;
				temp_pow=temp_pow*10;
			}					
			
			Symvol_write_debug(0,7,50);		// R

			int32_t t_grad;	
			if(roll_g>0)
			{
				temp_data=roll_g;
				t_grad=roll_g;
			}
			else
			{

				temp_data=-roll_g;
				t_grad=-roll_g;
				Symvol_write_debug(9,7,13);		// -
			}
			for(i=0,temp_pow=1;temp_pow<=t_grad;i++)
			{
					temp=temp_data%10;
					Symvol_write_debug(21-i*6,7,16+temp);		// 
					temp_data=temp_data/10;
					temp_pow=temp_pow*10;
			}
			
			Symvol_write_debug(30,7,48);	// P
			Symvol_write_debug(36,7,41);	// I
			Symvol_write_debug(42,7,52);	// T
			
			if(pitch_g>0)
			{
				temp_data=pitch_g;
				t_grad=pitch_g;
			}
			else
			{
				temp_data=-pitch_g;
				t_grad=-pitch_g;
				Symvol_write_debug(50,7,13);		// -
			}
			for(i=0,temp_pow=1;temp_pow<=t_grad;i++)
			{
				temp=temp_data%10;
				Symvol_write_debug(62-i*6,7,16+temp);		// 
				temp_data=temp_data/10;
				temp_pow=temp_pow*10;
			}
			
			Symvol_write_debug(0,5,39);		// G
			Symvol_write_debug(6,5,48);		// P
			Symvol_write_debug(12,5,51);		// S
			Symvol_write_debug(24,5,44);		// L
			Symvol_write_debug(30,5,33);		// A
			Symvol_write_debug(36,5,52);	// T
			Symvol_write_debug(42,5,13);	// -
			Symvol_write_debug(48,5,52);	// T

			if(lat_dist>0)
			{				
				temp_data=(uint32_t) lat_dist;	
				for(i=0,temp_pow=1;temp_pow<=lat_dist;i++)
				{
						temp=temp_data%10;
						Symvol_write_debug(112-i*6,5,16+temp);		// 
						if(temp_pow==1000000)
						{
							i++;
							Symvol_write_debug(112-i*6,5,14);		// . 
						}
						temp_data=temp_data/10;
						temp_pow=temp_pow*10;
				}		
			}
			Symvol_write_debug(0,6,39);		// G
			Symvol_write_debug(6,6,48);		// P
			Symvol_write_debug(12,6,51);		// S
			Symvol_write_debug(24,6,44);		// L
			Symvol_write_debug(30,6,47);		// O
			Symvol_write_debug(36,6,46);	// N
			Symvol_write_debug(42,6,13);	// -
			Symvol_write_debug(48,6,52);	// T
			
			if(lon_dist>0)
			{	
				temp_data=(uint32_t) lon_dist;	
				for(i=0,temp_pow=1;temp_pow<=lon_dist;i++)
				{
						temp=temp_data%10;
						Symvol_write_debug(112-i*6,6,16+temp);		// 
						if(temp_pow==1000000)
						{
							i++;
							Symvol_write_debug(112-i*6,6,14);		// . 
						}
						temp_data=temp_data/10;
						temp_pow=temp_pow*10;
				}	
			}
			}
			else
			{
			Symvol_write_Led(4,0,36);	// D
			Symvol_write_Led(12,0,41);	// I
			Symvol_write_Led(20,0,51);	// S
			Symvol_write_Led(28,0,52);	// T
			if(((uint32_t) dist)<20000)
			{			
				temp_data=(uint32_t) dist;	
				for(i=0,temp_pow=1;temp_pow<=(uint32_t) dist;i++)
				{
						temp=temp_data%10;
						Symvol_write_Led(72-i*8,0,16+temp);		// 
						if(temp_pow==1)
						{
							i++;
							Symvol_write_Led(72-i*8,0,14);		// . 
						}
						temp_data=temp_data/10;
						temp_pow=temp_pow*10;

				}
			}
			
			
		if(work_state==1)
		{
				SSD1306_DrawFilledRect_2(99,0,0xff);
				for(i=0;i<20;i++)
				{
					if((batt_V/1000-7.4)>=i*0.05)
					{
						SSD1306_DrawFilledRect_2(100+i,0,0xff);
					}
					else
					{
						SSD1306_DrawFilledRect_2(100+i,0,0x81);
					}
				}
				SSD1306_DrawFilledRect_2(120,0,0x3c);
				SSD1306_DrawFilledRect_2(121,0,0x3c);
			}
			Symvol_write_Led(4,6,33);	// A
			Symvol_write_Led(12,6,58);	// Z
			Symvol_write_Led(20,6,45);	// M
			
			if(((uint32_t)hdg)<36000)
			{			
				temp_data=(uint32_t) hdg;	
				for(i=0,temp_pow=1;temp_pow<=hdg;i++)
				{
					temp=temp_data%10;
					Symvol_write_Led(82-i*8,6,16+temp);		// 
					if(temp_pow==10)
					{
						i++;
						Symvol_write_Led(82-i*8,6,14);		// . 
					}
					temp_data=temp_data/10;
					temp_pow=temp_pow*10;
				}					
			}


			Symvol_write_Led(4,2,39);			// G
			Symvol_write_Led(12,2,48);			// P
			Symvol_write_Led(20,2,51);		// S
			Symvol_write_Led(28,2,54);		// V
			if( lat_dist>0)
			{				
				temp_data=(uint32_t) lat_dist;	
				for(i=0,temp_pow=1;temp_pow<=lat_dist;i++)
				{
						temp=temp_data%10;
						Symvol_write_Led(116-i*8,2,16+temp);		// 
						if(temp_pow==1000000)
						{
							i++;
							Symvol_write_Led(116-i*8,2,14);		// . 
						}
						temp_data=temp_data/10;
						temp_pow=temp_pow*10;
				}		
			}
			Symvol_write_Led(4,4,39);			// G
			Symvol_write_Led(12,4,48);			// P
			Symvol_write_Led(20,4,51);		// S
			Symvol_write_Led(28,4,40);		// H			

			if(lon_dist>0)
			{
			temp_data=(uint32_t) lon_dist;	
			for(i=0,temp_pow=1;temp_pow<=lon_dist;i++)
			{
					temp=temp_data%10;
					Symvol_write_Led(116-i*8,4,16+temp);		// 
					if(temp_pow==1000000)
					{
						i++;
						Symvol_write_Led(116-i*8,4,14);		// . 
					}
					temp_data=temp_data/10;
					temp_pow=temp_pow*10;
			}	
		}
		}
		SSD1306_UpdateScreen();
		HAL_Delay(50);
}


/* USER CODE END 0 */

/**
  * @brief  The application entry point.
  * @retval int
  */
int main(void)
{

  /* USER CODE BEGIN 1 */
	uint32_t temp_pow,i,j;
	volatile	uint32_t k;
  /* USER CODE END 1 */

  /* MCU Configuration--------------------------------------------------------*/

  /* Reset of all peripherals, Initializes the Flash interface and the Systick. */
  HAL_Init();

  /* USER CODE BEGIN Init */

  /* USER CODE END Init */

  /* Configure the system clock */
  SystemClock_Config();

  /* USER CODE BEGIN SysInit */

  /* USER CODE END SysInit */

  /* Initialize all configured peripherals */
  MX_GPIO_Init();
  MX_DMA_Init();
  MX_I2C1_Init();
  MX_USART2_UART_Init();
  MX_USART1_UART_Init();
  MX_ADC1_Init();
  MX_TIM3_Init();
  MX_TIM2_Init();
  /* USER CODE BEGIN 2 */
  SSD1306_Init();
  SSD1306_ClearScreen();
	SSD1306_UpdateScreen();
	HAL_Delay(25);
  while(SSD1306_IsReady() == 0);
  time=0;  
	
	roll=1;
	yaw=-0.5;
	roll_g=30;
	pitch_g=0;
	pitch=Pi*pitch_g/180;
	yaw_g=30;
	dist=0;//1000;
	hdg=0;//9000;
	hdg_r=Pi*hdg/18000;
	lat=547654321;
	lon=347654321;
	alt=2020001;
	gor_dist=cos(pitch)*dist/10;
	lon_r=lon*Pi/1800000000;
	
	lon_m_g=lon_ekv*sin(lon_r);
	lat_dist=cos(hdg_r)*gor_dist*10000000/lat_m_g;
	lon_dist=sin(hdg_r)*gor_dist*10000000/lon_m_g;
	lat_dist=0;//547654321;
	lon_dist=0;//347654321;
	temp_f[0]=cos(pitch);
	temp_f[1]=sin(roll);
	temp_f[2]=tan(yaw);
	count=0;
//	HAL_UART_Transmit_IT(&huart1, Laser_off, laser_lengh);
//	HAL_UART_Receive_IT(&huart1, receiveBuffer, 8);
	Laser_state=0;
	Receive_on=0;
	batt_count=0;
	batt_V=0;
	timer_end=0;
	second_end=0;
	timer_step=5;
	timer_count=0;
	work_state=0;
	gps_count=0;
	debug=0;
	new_meas=0;
	Go_laser=1;
	//HAL_TIM_Base_Start_IT(&htim3);
	HAL_TIM_Base_Start_IT(&htim2);
  /* USER CODE END 2 */

  /* Infinite loop */
  /* USER CODE BEGIN WHILE */
  while (1)
  {
    /* USER CODE END WHILE */

    /* USER CODE BEGIN 3 */
		

		if(timer_end==1)
		{

			timer_end=0;			
		}
		if(Go_laser==1)
		{
			lat_dist=0;
			lon_dist=0;
			for(i=0;i<dist_buffer_size;i++)
			{dist_buffer[i]=0;}
			HAL_UART_Transmit_IT(&huart1, command_word1, Command_lengh);
			k=0;
			Receive_on=1;
			timer_step=50;
			while((Receive_on==1))
			{
				HAL_UART_Receive(&huart1,&dist_buffer[k],1,100);
				if((dist_buffer[k]==0xAE))
				{
					timer_step=50;
					k++;
					while((Receive_on==1))
					{
						HAL_UART_Receive(&huart1,&dist_buffer[k],1,10);
						if((dist_buffer[k]==0xA7))
						{
							k++;
							while((Receive_on==1)&(k<27))
							{
								HAL_UART_Receive(&huart1,&dist_buffer[k],1,5);
								k++;
							}		
							if(dist_buffer[4]==0x85)
							{
  							dist=dist_buffer[12]|(dist_buffer[11]<<8);
								Receive_on=0;
								timer_step=100;
								new_meas=1;
//								if(gps_count>=5)
//								{
//									gor_dist=cos(pitch)*dist/10;
//									hdg_r=Pi*hdg/18000;
//									lat_r=lat*Pi/1800000000;
//									lon_m_g=lon_ekv*cos(lat_r);
//									lon_dist=sin(hdg_r)*gor_dist*10000000/lon_m_g;
//									lat_dist=cos(hdg_r)*gor_dist*10000000/lat_m_g;
//									lon_dist=lon+lon_dist;
//									lat_dist=lat+lat_dist;
//								}

							}
							else
							{
								Receive_on=0;
								dist=0;
								timer_step=100;
							}
						}
					}
				}
			}
			Go_laser=0;
		}	

 		if(HAL_GPIO_ReadPin(GPIOC,GPIO_PIN_14)==1)
		{
			debug=1;
		}
		else
		{
			debug=0;
		}
		if(HAL_GPIO_ReadPin(GPIOB,GPIO_PIN_12)==1)
		{
			if(Laser_state==1)
			{
				HAL_UART_Transmit_IT(&huart1, Laser_off, laser_lengh);
				Laser_state=0;
			}
		}
		else
		{
			if(Laser_state==0)
			{
				if(debug==1)
				{
					HAL_UART_Transmit_IT(&huart1, Laser_Calibration , Command_lengh);
				}
				else
				{
					HAL_UART_Transmit_IT(&huart1, Laser_on, laser_lengh);
				}
				Laser_state=1;
			}
		}
	
		if(second_end==1)
		{
			if(work_state==0)
			{
				HAL_GPIO_TogglePin(GPIOA,GPIO_PIN_6);
			}
			else
			{
				if(gps_count>=9)
				{
					HAL_GPIO_WritePin(GPIOA,GPIO_PIN_5,0);
					HAL_GPIO_WritePin(GPIOA,GPIO_PIN_7,1);
				}
				else
				{
					HAL_GPIO_WritePin(GPIOA,GPIO_PIN_7,0);
					HAL_GPIO_WritePin(GPIOA,GPIO_PIN_5,1);
				}
			}
			
			second_end=0;
			write_Led();
			count=0;
			HAL_UART_DMAStop(&huart1);			
			for(i=0;i<BUFFER_SIZE-300;i++)
			{
				if(receiveBuffer[i]==0xFD)
				{
					if(receiveBuffer[i+receiveBuffer[i+1]+12]==0xFD)
					{
						temp=receiveBuffer[i+7]|(receiveBuffer[i+8]<<8)|(receiveBuffer[i+9]<<16);
						if(temp==0x1e)
						{
							work_state=1;
							HAL_GPIO_WritePin(GPIOA,GPIO_PIN_6,0);
							roll_temp=receiveBuffer[i+14]|(receiveBuffer[i+15]<<8)|(receiveBuffer[i+16]<<16)|(receiveBuffer[i+17]<<24);
							point=&roll_temp;
							roll=*point;
							roll_g=(int32_t) ((roll*180)/Pi);
							pitch_temp=receiveBuffer[i+18]|(receiveBuffer[i+19]<<8)|(receiveBuffer[i+20]<<16)|(receiveBuffer[i+21]<<24);
							point=&pitch_temp;
							pitch=*point;
							pitch_g=(int32_t) ((pitch*180)/Pi);
							yaw_temp=receiveBuffer[i+22]|(receiveBuffer[i+23]<<8)|(receiveBuffer[i+24]<<16)|(receiveBuffer[i+25]<<24);
							point=&yaw_temp;
							yaw=*point;
							yaw_g=(int32_t) ((yaw*180)/Pi);
//							gor_dist=cos(pitch)*dist/10;
						}
						if(temp==0x21)
						{
							lat=receiveBuffer[i+14]|(receiveBuffer[i+15]<<8)|(receiveBuffer[i+16]<<16)|(receiveBuffer[i+17]<<24);
							lon=receiveBuffer[i+18]|(receiveBuffer[i+19]<<8)|(receiveBuffer[i+20]<<16)|(receiveBuffer[i+21]<<24);
							alt=receiveBuffer[i+22]|(receiveBuffer[i+23]<<8)|(receiveBuffer[i+24]<<16)|(receiveBuffer[i+25]<<24);
//							hdg=receiveBuffer[i+36]|(receiveBuffer[i+37]<<8);
//							temp_data1=receiveBuffer[i+36];
//							temp_data2=receiveBuffer[i+1];
							if(receiveBuffer[i+1]==0x1b)
							{
								hdg=receiveBuffer[i+36];
							}
							else
							{
								hdg=receiveBuffer[i+36]|(receiveBuffer[i+37]<<8);
							}
							hdg_r=Pi*hdg/18000;
							if(new_meas==1)
							{new_meas=2;}
						}
						if(temp==0x18)
						{
//							pointer=&receiveBuffer[i+10];
//							GPS_temp=*pointer;
							gps_status=receiveBuffer[i+18];
							gps_count=receiveBuffer[i+39];	
		//						if((gps_status&0x03)!=0)
		//						{
		//						time=receiveBuffer[i+10]|(receiveBuffer[i+11]<<8)|(receiveBuffer[i+12]<<16)|(receiveBuffer[i+13]<<24)|(receiveBuffer[i+14]<<32)|(receiveBuffer[i+15]<<40)|(receiveBuffer[i+16]<<48)|(receiveBuffer[i+17]<<56);
//								lat=receiveBuffer[i+18]|(receiveBuffer[i+19]<<8)|(receiveBuffer[i+20]<<16)|(receiveBuffer[i+21]<<24);
//								lon=receiveBuffer[i+22]|(receiveBuffer[i+23]<<8)|(receiveBuffer[i+24]<<16)|(receiveBuffer[i+25]<<24);
//								alt=receiveBuffer[i+26]|(receiveBuffer[i+27]<<8)|(receiveBuffer[i+28]<<16)|(receiveBuffer[i+29]<<24);
							
//								lon_r=lon*Pi/1800000000;
//								lat_r=lat*Pi/1800000000;
//								lon_m_g=lon_ekv*cos(lat_r);
//								lon_dist=sin(hdg_r)*gor_dist*10000000/lon_m_g;
//								lat_dist=cos(hdg_r)*gor_dist*10000000/lat_m_g;
//		//						}
//								cog=receiveBuffer[i+36]|(receiveBuffer[i+37]<<8);
//								hdg_r=Pi*hdg/18000;
						}
						if(temp==0x01)
						{
							batt_V=receiveBuffer[i+24]|(receiveBuffer[i+25]<<8);
						}
						i=i+11+receiveBuffer[i+1];
					}
				}
		}
		for(i=0;i<BUFFER_SIZE;i++)
		{receiveBuffer[i]=0;}
		if(new_meas==2)
		{
			if(gps_count>=5)
			{
				gor_dist=cos(pitch)*dist/10;
				hdg_r=Pi*hdg/18000;
				lat_r=lat*Pi/1800000000;
				lon_m_g=lon_ekv*cos(lat_r);
				lon_dist=sin(hdg_r)*gor_dist*10000000/lon_m_g;
				lat_dist=cos(hdg_r)*gor_dist*10000000/lat_m_g;
				lon_dist=lon+lon_dist;
				lat_dist=lat+lat_dist;
			}
			new_meas=0;
		}
		//HAL_UART_DMAResume(&huart2);
	
    SSD1306_ClearScreen();
		HAL_UART_Receive_DMA(&huart2,receiveBuffer,BUFFER_SIZE);		
  }
	}
	
	
  /* USER CODE END 3 */
}

/**
  * @brief System Clock Configuration
  * @retval None
  */
void SystemClock_Config(void)
{
  RCC_OscInitTypeDef RCC_OscInitStruct = {0};
  RCC_ClkInitTypeDef RCC_ClkInitStruct = {0};
  RCC_PeriphCLKInitTypeDef PeriphClkInit = {0};

  /** Initializes the RCC Oscillators according to the specified parameters
  * in the RCC_OscInitTypeDef structure.
  */
  RCC_OscInitStruct.OscillatorType = RCC_OSCILLATORTYPE_HSE;
  RCC_OscInitStruct.HSEState = RCC_HSE_ON;
  RCC_OscInitStruct.HSEPredivValue = RCC_HSE_PREDIV_DIV1;
  RCC_OscInitStruct.HSIState = RCC_HSI_ON;
  RCC_OscInitStruct.PLL.PLLState = RCC_PLL_ON;
  RCC_OscInitStruct.PLL.PLLSource = RCC_PLLSOURCE_HSE;
  RCC_OscInitStruct.PLL.PLLMUL = RCC_PLL_MUL2;
  if (HAL_RCC_OscConfig(&RCC_OscInitStruct) != HAL_OK)
  {
    Error_Handler();
  }

  /** Initializes the CPU, AHB and APB buses clocks
  */
  RCC_ClkInitStruct.ClockType = RCC_CLOCKTYPE_HCLK|RCC_CLOCKTYPE_SYSCLK
                              |RCC_CLOCKTYPE_PCLK1|RCC_CLOCKTYPE_PCLK2;
  RCC_ClkInitStruct.SYSCLKSource = RCC_SYSCLKSOURCE_PLLCLK;
  RCC_ClkInitStruct.AHBCLKDivider = RCC_SYSCLK_DIV1;
  RCC_ClkInitStruct.APB1CLKDivider = RCC_HCLK_DIV2;
  RCC_ClkInitStruct.APB2CLKDivider = RCC_HCLK_DIV1;

  if (HAL_RCC_ClockConfig(&RCC_ClkInitStruct, FLASH_LATENCY_0) != HAL_OK)
  {
    Error_Handler();
  }
  PeriphClkInit.PeriphClockSelection = RCC_PERIPHCLK_ADC;
  PeriphClkInit.AdcClockSelection = RCC_ADCPCLK2_DIV2;
  if (HAL_RCCEx_PeriphCLKConfig(&PeriphClkInit) != HAL_OK)
  {
    Error_Handler();
  }
}

/* USER CODE BEGIN 4 */
void HAL_TIM_PeriodElapsedCallback(TIM_HandleTypeDef *htim)
{
		timer_end=1;
		if(timer_step>0)
		timer_step--;
		if(timer_step==0)
		{Receive_on=0;}
		if(timer_count>10)
		{
			timer_count=0;
			second_end=1;
		}
		else
		{
			timer_count++;
		}
    //HAL_GPIO_TogglePin(GPIOD, GPIO_PIN_12);
}
/* USER CODE END 4 */

/**
  * @brief  This function is executed in case of error occurrence.
  * @retval None
  */
void Error_Handler(void)
{
  /* USER CODE BEGIN Error_Handler_Debug */
  /* User can add his own implementation to report the HAL error return state */
  __disable_irq();
  while (1)
  {
  }
  /* USER CODE END Error_Handler_Debug */
}

#ifdef  USE_FULL_ASSERT
/**
  * @brief  Reports the name of the source file and the source line number
  *         where the assert_param error has occurred.
  * @param  file: pointer to the source file name
  * @param  line: assert_param error line source number
  * @retval None
  */
void assert_failed(uint8_t *file, uint32_t line)
{
  /* USER CODE BEGIN 6 */
  /* User can add his own implementation to report the file name and line number,
     ex: printf("Wrong parameters value: file %s on line %d\r\n", file, line) */
  /* USER CODE END 6 */
}
#endif /* USE_FULL_ASSERT */
